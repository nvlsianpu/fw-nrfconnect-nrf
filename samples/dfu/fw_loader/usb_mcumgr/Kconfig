## samples/dfu/fw_loader/usb_mcumgr/Kconfig
```kconfig
# Copyright (c) 2026 Nordic Semiconductor ASA
#
# SPDX-License-Identifier: LicenseRef-Nordic-5-Clause

menuconfig FW_LOADER_CUSTOM_USB
	bool "Use custom USB CDC ACM (multiple COM ports)"
	depends on USBD_CDC_ACM_CLASS
	help
	  Use sample-provided cdc_acm_serial init that registers all CDC ACM
	  instances from devicetree (e.g. mcumgr on first port, log on second).
	  When enabled, set CONFIG_CDC_ACM_SERIAL_INITIALIZE_AT_BOOT=n in prj.conf
	  so Zephyr does not build its cdc_acm_serial.c (this sample provides it).

if FW_LOADER_CUSTOM_USB

config CDC_ACM_SERIAL_ENABLE_AT_BOOT
	bool "USB device will be enabled at boot"
	default y

config CDC_ACM_SERIAL_MANUFACTURER_STRING
	string "USB device manufacturer string descriptor"
	default "Nordic Semiconductor ASA"

config CDC_ACM_SERIAL_PRODUCT_STRING
	string "USB device product string descriptor"
	default "MCUmgr DFU"

config CDC_ACM_SERIAL_VID
	hex "USB device Vendor ID"
	default 0x1915
	help
	  Use your own VID for production.

config CDC_ACM_SERIAL_PID
	hex "USB device Product ID"
	default 0x0004
	help
	  Use your own PID for production.

config CDC_ACM_SERIAL_SELF_POWERED
	bool "USB device Self-powered attribute"
	default n

config CDC_ACM_SERIAL_MAX_POWER
	int "USB device bMaxPower value (2 mA units)"
	default 125
	range 0 250

endif # FW_LOADER_CUSTOM_USB

source "Kconfig.zephyr"
```
